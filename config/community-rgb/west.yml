## config/community-rgb/west.yml
```yaml
manifest:
  remotes:
    - name: darknao
      url-base: https://github.com/darknao
  projects:
    - name: zmk
      remote: darknao
      revision: 8aeaaa66fbb4b94948c8763e06f1920ab0b69480
      import: app/west.yml
  self:
    path: config
```

## config/stock/west.yml
```yaml
manifest:
  remotes:
    - name: moergo-sc
      url-base: https://github.com/moergo-sc
  projects:
    - name: zmk
      remote: moergo-sc
      revision: ce69e85f585c724142aae37ddf8a7e019ff19e93
      import: app/west.yml
  self:
    path: config
```
